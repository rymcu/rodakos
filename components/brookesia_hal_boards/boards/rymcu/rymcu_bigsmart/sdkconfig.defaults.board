## components/brookesia_hal_boards/boards/rymcu/rymcu_bigsmart/sdkconfig.defaults.board
```kconfig
CONFIG_ESPTOOLPY_FLASHMODE_QIO=y
CONFIG_ESPTOOLPY_FLASHSIZE_16MB=y
CONFIG_ESPTOOLPY_FLASHFREQ_80M=y
CONFIG_PARTITION_TABLE_CUSTOM=y
CONFIG_PARTITION_TABLE_CUSTOM_FILENAME="partitions_16m.csv"
CONFIG_PARTITION_TABLE_FILENAME="partitions_16m.csv"
CONFIG_SPIRAM=y
CONFIG_SPIRAM_MODE_OCT=y
CONFIG_SPIRAM_SPEED_80M=y
CONFIG_SPIRAM_MALLOC_ALWAYSINTERNAL=0
CONFIG_SPIRAM_MALLOC_RESERVE_INTERNAL=131072
# CONFIG_SPIRAM_XIP_FROM_PSRAM is not set
CONFIG_SPIRAM_FETCH_INSTRUCTIONS=y
CONFIG_SPIRAM_TRY_ALLOCATE_WIFI_LWIP=y
CONFIG_SPIRAM_ALLOW_BSS_SEG_EXTERNAL_MEMORY=y
CONFIG_SPIRAM_ALLOW_NOINIT_SEG_EXTERNAL_MEMORY=y
CONFIG_IDF_EXPERIMENTAL_FEATURES=y
CONFIG_ESP_DEFAULT_CPU_FREQ_MHZ_240=y
CONFIG_ESP32S3_DATA_CACHE_LINE_64B=y
CONFIG_COMPILER_OPTIMIZATION_PERF=y
CONFIG_ESP_CONSOLE_USB_SERIAL_JTAG=y

# Brookesia:Service:NVS
CONFIG_NVS_ALLOCATE_CACHE_IN_SPIRAM=y

# Brookesia:Service:Wifi
CONFIG_ESP_SYSTEM_EVENT_TASK_STACK_SIZE=3072

# Camera
CONFIG_CAMERA_GC0308=y
CONFIG_CAMERA_GC0308_AUTO_DETECT_DVP_INTERFACE_SENSOR=y
CONFIG_CAMERA_GC0308_DVP_RGB565_BE_320X240_20FPS=y
CONFIG_CAMERA_GC0308_DVP_DEFAULT_FMT_RGB565_BE_320X240_20FPS=y
```

## main/Kconfig.projbuild
```kconfig
menu "RodakOS voice processing"

config USE_DEVICE_AEC
    bool "Use ESP-SR device AEC"
    default y
    help
        Run echo cancellation on the BigSmart device before uplink.

config USE_SERVER_AEC
    bool "Use timestamped server AEC"
    default n
    depends on !USE_DEVICE_AEC

config RODAKOS_WAKE_AEC
    bool "Cancel speaker echo before local wake detection"
    default y
    help
        Runs ESP-SR AEC against the ES8311 loopback (MIC3) in front of MultiNet, so the
        wake word can be heard while music plays.

config RODAKOS_WAKE_AGC
    bool "Apply automatic gain before local wake detection"
    default y
    help
        Runs ESP-SR WebRTC AGC in front of MultiNet so quiet, distant speech reaches
        the level MultiNet was trained on.

config RODAKOS_WAKE_CHIME
    bool "Play a short chime when the wake word is accepted"
    default y
    help
        Confirms a local wake immediately, before the cloud session is ready.
        The chime overlaps WebSocket setup instead of adding to it.

endmenu
```

## recovery/sdkconfig.defaults
```kconfig
CONFIG_ESPTOOLPY_FLASHSIZE_16MB=y
CONFIG_ESPTOOLPY_FLASHMODE_QIO=y
CONFIG_PARTITION_TABLE_CUSTOM=y
CONFIG_PARTITION_TABLE_CUSTOM_FILENAME="../partitions_16m.csv"
CONFIG_BOOTLOADER_APP_ROLLBACK_ENABLE=y
CONFIG_COMPILER_OPTIMIZATION_SIZE=y
CONFIG_COMPILER_DISABLE_DEFAULT_ERRORS=y
CONFIG_COMPILER_ORPHAN_SECTIONS_WARNING=y
CONFIG_LOG_DEFAULT_LEVEL_INFO=y
```
